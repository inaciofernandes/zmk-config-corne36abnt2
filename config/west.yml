## config/west.yml
```yaml
manifest:
  remotes:
    - name: zmkfirmware
      url-base: https://github.com/zmkfirmware
  projects:
    - name: zmk
      remote: zmkfirmware
#      revision: main
#      revision: v0.2.1
      revision: v0.3.0
      import: app/west.yml
  self:
    path: config
```
